## drivers/sensors/Kconfig
```kconfig
# SPDX-License-Identifier: GPL-2.0-only
config SENSORS_ALSPS
	tristate "ALSPS sensor for light and proximity"
	default m
	help
	  Say Y here if you want to support ALSPS
	  connected via an I2C bus.

	  To compile this driver as a module, choose M here: the
	  module will be called ALSPS.
```
